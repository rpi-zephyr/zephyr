## boards/raspberrypi_ng/rpi_5_ng/board.yml
```yaml
board:
  name: rpi_5_ng
  full_name: Raspberry Pi 5 NG (Cortex-A76)
  vendor: raspberrypi_ng
  socs:
  - name: bcm2712
```

## boards/raspberrypi_ng/rpi_5_ng/rpi_5_ng_defconfig
```kconfig
# SPDX-License-Identifier: Apache-2.0

CONFIG_ARM64_VA_BITS_40=y
CONFIG_ARM64_PA_BITS_40=y
CONFIG_TIMER_READS_ITS_FREQUENCY_AT_RUNTIME=y

# Enable serial console.
CONFIG_SERIAL=y
CONFIG_CONSOLE=y
CONFIG_UART_CONSOLE=y

CONFIG_PCIE=y
CONFIG_PCIE_CONTROLLER=y

CONFIG_PICOLIBC=n
CONFIG_MINIMAL_LIBC=y

# Bootloader(TF-A)
CONFIG_BUILD_WITH_TFA=y
CONFIG_TFA_MAKE_BUILD_TYPE_DEBUG=y
```

## modules/u-boot/Kconfig
```kconfig
# SPDX-License-Identifier: Apache-2.0

config ZEPHYR_UBOOT_MODULE
	bool

menuconfig BUILD_WITH_UBOOT
	bool "Build with u-boot"
	help
	  When enabled, this option instructs the Zephyr build process to
	  additionally generate a u-boot image.
```
